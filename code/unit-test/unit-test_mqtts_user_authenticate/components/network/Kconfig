## code/unit-test/unit-test_mqtts_user_authenticate/components/network/Kconfig
```kconfig
menu "LoraGateway Network Configuration"
    config ESP_WIFI_SSID
        string "WiFi SSID"
        default "myssid"
        help
            SSID (network name) 

    config ESP_WIFI_PASSWORD
        string "WiFi Password"
        default "mypassword"
        help
            WiFi password (WPA or WPA2) 

    config MQTT_URI
        string "MQTT URI path"
        default ""
        help
            The URI path for the MQTT to connect to

    config MQTT_USERNAME
        string "MQTT Username"
        default ""
        help
            Username to connect to MQTT

    config MQTT_PASSWORD
        string "MQTT password"
        default ""
        help
            Password of MQTT username

    choice NETWORK_CONNECT_METHOD
        prompt "Select WiFi or Ethernet to connect"
        default NETWORK_WIFI
        help
            Select WiFi or Ethernet W5500 of Gateway to connect to the network
        config NETWORK_WIFI
            bool "WiFi"
        config NETWORK_ETH
            bool "Ethernet W5500"
    endchoice
endmenu
```
